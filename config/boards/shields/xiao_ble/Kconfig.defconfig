## config/boards/shields/xiao_ble/Kconfig.defconfig
```kconfig
if SHIELD_XIAO_BLE_LEFT
    config ZMK_KEYBOARD_NAME
        default "K3Y$"
    config ZMK_SPLIT_ROLE_CENTRAL
        default y
endif

if SHIELD_XIAO_BLE_LEFT || SHIELD_XIAO_BLE_RIGHT
    config ZMK_SPLIT
        default y
endif
```

## config/boards/shields/xiao_ble/Kconfig.shield
```kconfig
config SHIELD_XIAO_BLE_LEFT
    def_bool $(shields_list_contains,xiao_ble_left)
    select SHIELD_XIAO_BLE

config SHIELD_XIAO_BLE_RIGHT
    def_bool $(shields_list_contains,xiao_ble_right)
    select SHIELD_XIAO_BLE
```
